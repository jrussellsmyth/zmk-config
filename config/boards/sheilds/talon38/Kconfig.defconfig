## config/boards/shields/talon38/Kconfig.shield
```kconfig
config SHIELD_TALON38_LEFT
    def_bool $(shields_list_contains,talon38_left)

config SHIELD_TALON38_RIGHT
    def_bool $(shields_list_contains,talon38_right)
```
